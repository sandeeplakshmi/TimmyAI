## firmware/main/Kconfig.projbuild
```kconfig
# Copyright (c) Meta Platforms, Inc. and affiliates.
#
# Licensed under the Apache License, Version 2.0 (the "License");
# you may not use this file except in compliance with the License.
# You may obtain a copy of the License at
#
#     http://www.apache.org/licenses/LICENSE-2.0
#
# Unless required by applicable law or agreed to in writing, software
# distributed under the License is distributed on an "AS IS" BASIS,
# WITHOUT WARRANTIES OR CONDITIONS OF ANY KIND, either express or implied.
# See the License for the specific language governing permissions and
# limitations under the License.
#
# Modified by the Timmy contributors, 2026
# SPDX-License-Identifier: Apache-2.0

menu "ESP32 Device SDK"

    config GADGET_PRODUCT_NAME
        string "Human-visible product name for log messages"
        default "Timmy Gadget"
        help
            The product name shown in boot banners, log messages, and
            diagnostic text. Does not affect protocol identifiers or
            backend strings. Internal builds override this to match
            the shipping product name.

    config TIMMY_DEVICE_MODEL_ID
        string "Device model id"
        default "timmy-gadget"
        help
            The hardware model this device registers with Timmy (model_id in
            link.register): 1 to 64 lowercase letters, digits and hyphens.
            Profiles of the same hardware share one id. Each board overlay in
            devices/ sets its own. See protocols/DEVICE.md.

    config TIMMY_DEVICE_MODEL_NAME
        string "Device model name"
        default "Timmy Gadget"
        help
            The hardware's name as people know it, sent to Timmy as
            metadata.model_name in link.register: 1 to 128 printable ASCII
            characters, without " or \. Each board overlay in devices/ sets
            its own.

    config TIMMY_DEVICE_GUIDE
        string "Device guide (Markdown file)"
        default "main/guide.md"
        help
            The Markdown file device.guide returns to Timmy: what the device
            is, its controls and its limits. A relative path is looked up in
            the project directory, then in esp32/. The build fails if the
            guide is over 4096 bytes. See protocols/DEVICE.md.

    config GADGET_SDK_TOKEN
        string "Timmy Gadgets SDK token"
        default ""
        help
            Your mgst_ SDK token from the vendor developer site (Account > SDK tokens).
            Every gadget needs one to pair. The device hands it to the Timmy
            app inside the encrypted pairing session and includes it when it
            refreshes its device token. A token set over serial
            (">sdk_token=mgst_..." on the console, as the web flasher does)
            is stored in NVS and takes precedence over this one.

    config HOMEHUB_WIFI_MIN_MODEM
        bool "Wi-Fi minimum modem power saving at startup"
        default n
        help
            Let the station sleep between access-point DTIM beacons while
            keeping its Wi-Fi connection. Incoming traffic may wait until
            the next DTIM. Enabled by the reTerminal E1002 profile after
            battery runtime testing; other profiles retain their defaults.
            Boards with a runtime Wi-Fi power policy may override this mode.

    config HOMEHUB_WIFI_SSID
        string "WiFi SSID override (dev iteration)"
        default ""
        help
            If non-empty, the firmware connects to this SSID at boot
            without waiting for a BLE provisioning command. Useful for
            iterating on tunnel throughput without re-pairing each flash.
            BLE still follows setup state: it only advertises when setup is
            incomplete. If no device token pair is in NVS, the tunnel stays
            down and the device waits for BLE provisioning.

    config HOMEHUB_WIFI_PASSWORD
        string "WiFi password override"
        default ""
        help
            Password for CONFIG_HOMEHUB_WIFI_SSID. Ignored when the SSID
            override is empty.

    config HOMEHUB_TOKEN_REFRESH_INTERVAL_DAYS
        int "Proactive device token refresh interval (days, 0 = disabled)"
        range 0 365
        default 30
        help
            Safety net against the access token's real lifetime being shorter
            than the 365 days the API service advertises. Normal operation refreshes
            reactively, only when a token is refused; this adds a slow periodic
            refresh on top.

            Measured against UPTIME, not the calendar — the device has no clock
            and NVS here stores strings only. A device that reboots more often
            than this interval never triggers it, which is fine: every boot
            re-validates the token via fetch_vms and a 401 there drives the
            reactive path. This exists for devices that stay up for months.

            Each refresh is one call to the endpoint that can mint unusable
            tokens after an idle period, so keep this long. Set 0 to disable.

    config HOMEHUB_OTA_ENABLED
        bool "Enable OTA firmware updates"
        default n
        help
            Allow firmware updates over authenticated control and BLE setup.
            When disabled, OTA commands are not advertised and update requests
            are skipped without downloading, even when force is requested.
            Optional OTA parameters in Wi-Fi setup are ignored so provisioning
            can finish normally. Internal builds enable this explicitly.

    config HOMEHUB_SUPPORT_BUG_REPORT
        bool "Enable private support bug reporting"
        default n
        help
            Accept the private bug.report command over authenticated remote
            control. Do not advertise it in generic node.register commands.
            The report can contain restricted support PII from the bounded
            current-boot application log, but never credentials,
            keys, signed URL queries, or arbitrary response bodies.
            The dedicated support path forwards the opaque JSON through the
            configured report endpoint as a private attachment
            and suppresses the payload from user-visible chat. Supported
            profiles enable this explicitly; the Kconfig fallback remains off
            for custom builds that bypass the supported sdkconfig defaults.

    config HOMEHUB_SHOW_AGENT_NAME
        bool "Show the agent's name on the display"
        default n
        help
            After the device registers, fetch GET /identity over the Noise
            session and show the agent's name on the status display. Only
            display backends (and the C3's text OLED) can show it, so it is
            off for LED-only builds.

    config HOMEHUB_TUNNEL
        bool "Enable the home-network tunnel and network discovery"
        default y
        help
            Open the /link-tunnel data-plane stream on the Noise session, bring
            up the NAPT tunnel netif, and accept device.discover. Together they
            need roughly 60 KB of internal RAM beyond the control session, plus
            up to 256 KB for discovery results, so boards without PSRAM (e.g.
            the classic ESP32) should disable this. The control API to the VM
            keeps working; the status turns green once the control session is up.

    config HOMEHUB_SETUP_TASKS_IN_PSRAM
        bool "Put the setup tasks' stacks in PSRAM"
        depends on SPIRAM && SPIRAM_FETCH_INSTRUCTIONS && SPIRAM_RODATA
        default n
        help
            Starts the pairing timers, the Wi-Fi scan refresh and the
            provisioning task (main/helper_task.h) with their stacks in PSRAM,
            sparing about 16 KB of internal RAM while setup runs. For a board
            whose overlay is short of internal RAM. It needs code and read-only
            data in PSRAM: flash writes then leave the cache on, and
            provisioning writes NVS, which asserts on a PSRAM stack otherwise.

    config HOMEHUB_BLE_PERSISTENT
        bool "Keep BLE running next to Wi-Fi and the Noise session"
        depends on BT_NIMBLE_ENABLED && !TIMMY_ENABLED
        default n
        help
            By default the NimBLE stack is shut down and its memory released
            once setup completes, so BLE never shares the radio or internal RAM
            with Wi-Fi and the VM session. With this on, the stack stays up
            after setup: setup advertising stops, and a basic GATT service
            (main/ble_basic.c) is advertised slowly so a phone or hub can
            still find and connect to the gadget. Re-pairing still needs the
            long-press reset (which restarts the gadget, dropping any BLE
            connection). Costs the NimBLE controller and host heap (roughly
            40 KB of internal RAM with the default buffers) for as long as the
            device runs. Needs CONFIG_BT_NIMBLE_MAX_CONNECTIONS >= 2: the
            service accepts one connection at a time (advertising stops while
            it is held), and the rest stay free for the gadget's own BLE use.

    config HOMEHUB_BLE_PERSISTENT_ADV_INTERVAL_MS
        int "Advertising interval after setup (ms)"
        depends on HOMEHUB_BLE_PERSISTENT
        range 100 10240
        default 1000
        help
            Interval for the slow, connectable advertising that keeps the
            device visible after setup. Setup advertising uses NimBLE's fast
            30-60 ms default; every advertising event takes the shared radio
            from Wi-Fi, so a slow interval keeps BLE's share of airtime small.

    config HOMEHUB_BLE_COEX
        bool "Wi-Fi first radio sharing while BLE stays up"
        depends on HOMEHUB_BLE_PERSISTENT && ESP_COEX_SW_COEXIST_ENABLE
        default y if IDF_TARGET_ESP32C5
        help
            The chip has one radio path for Wi-Fi and BLE, and ESP-IDF's
            coexistence scheduler gives BLE half of every Wi-Fi beacon period
            whenever BLE advertises, scans or is connected, even with nothing
            to send. Once setup is complete, this keeps BLE advertising (and,
            with the option below, BLE connections) from reserving that
            airtime: BLE events still get the radio when they need it, one at
            a time. Measured on the C5 DevKitC-1 with BLE advertising, tunnel
            throughput rose from about 2.1 to 4.1 Mbit/s each way, and a
            connected central's reads kept working. Scanning still takes its
            share. Main/ble_coex.h describes it; validated on the C5 only.

    config HOMEHUB_BLE_COEX_WIFI_FIRST_CONNECTED
        bool "Also while a BLE peer is connected"
        depends on HOMEHUB_BLE_COEX
        default y
        help
            Keep Wi-Fi first while a BLE connection is up too. Light BLE
            traffic (a phone reading the status characteristic) is unaffected;
            turn this off for a sustained BLE stream that needs its slots.

    config HOMEHUB_BLE_COMMANDS
        bool "Timmy commands for the Link's Bluetooth LE"
        depends on HOMEHUB_BLE_PERSISTENT && BT_NIMBLE_ROLE_CENTRAL && BT_NIMBLE_ROLE_OBSERVER && BT_NIMBLE_GATT_CLIENT
        default y
        help
            Lets Timmy turn BLE on and off, control the Link's own advertising,
            scan for nearby devices, connect to them (up to three at once),
            list their GATT services and characteristics, and read, write and
            subscribe to characteristics: ble.state, ble.power, ble.advertise,
            ble.scan, ble.connect, ble.disconnect, ble.discover, ble.read,
            ble.write and ble.subscribe (main/ble_commands.c). Needs the
            central, observer and GATT client roles
            (tools/coexist/sdkconfig.nimble-tuned keeps them).

    config HOMEHUB_BLE_THROUGHPUT_TEST
        bool "BLE throughput test characteristic"
        depends on HOMEHUB_BLE_PERSISTENT
        default n
        help
            Add a characteristic to the basic service for measuring BLE
            throughput beside Wi-Fi: writes without response are counted
            and dropped, and writing a 4-byte little-endian count to it makes
            the device notify that many bytes back. Bench builds only.

    config HOMEHUB_FAST_GCM
        bool "Faster AES-GCM GHASH (chips without a GCM engine)"
        depends on MBEDTLS_HARDWARE_AES && !MBEDTLS_HARDWARE_GCM
        default y if IDF_TARGET_ESP32C5 && SPIRAM
        default n
        help
            Wrap ESP-IDF's one-shot AES-GCM (used by TLS records and Noise
            transport messages through PSA) with main/fast_gcm.c: CTR on the
            AES DMA engine as before, GHASH with 32-bit tables cached per key
            instead of IDF's 64-bit 4-bit tables rebuilt on every call, and
            PSRAM data staged through internal RAM for the AES DMA.

            Measured on the C5 DevKitC-1: AES-256-GCM seal of an 8 KB frame
            in PSRAM 3.5 ms -> 2.0 ms. Checked against IDF's GCM by
            tests/test_ghash32.py and the bench's gcm_verify.

            Internal RAM: up to CONFIG_HOMEHUB_FAST_GCM_G8_TABLES 8-bit tables
            of 4 KB, allocated on first use, plus the static staging buffer
            (CONFIG_HOMEHUB_FAST_GCM_BOUNCE_BYTES) and ~1.3 KB of per-key
            state: about 19 KB with the defaults.

    config HOMEHUB_FAST_GCM_DEFAULT_MODE
        int "Fast GCM mode at boot (0 off, 1 4-bit tables, 2 8-bit tables)"
        depends on HOMEHUB_FAST_GCM
        range 0 2
        default 2
        help
            8-bit tables take 4 KB of internal RAM per cached key (up to four
            keys, allocated on first use) and halve GHASH's work again.

    config HOMEHUB_FAST_GCM_G8_TABLES
        int "8-bit GHASH tables to keep (4 KB internal RAM each)"
        depends on HOMEHUB_FAST_GCM
        range 0 4
        default 4 if SPIRAM
        default 0
        help
            One per AES key in use: the VM session's TLS link and its Noise
            transport use two each. Keys beyond this use 4-bit tables.

    config HOMEHUB_FAST_GCM_BOUNCE_BYTES
        int "Internal staging buffer for PSRAM data (bytes)"
        depends on HOMEHUB_FAST_GCM
        range 256 16384
        default 2048
        help
            Static internal RAM that PSRAM plaintext and ciphertext pass
            through on their way to the AES engine. Must be a multiple of 16
            (whole AES blocks); the build checks.

    config HOMEHUB_DAEMON_REQUESTS
        bool "Requests to Timmy's VM from your own code"
        default y
        help
            Lets firmware code open its own HTTP requests to the VM's
            daemon on Link's Noise session (noise_ctrl_req_open() and
            friends in main/noise_control.h): reading the chat history,
            or reading and writing files on the user's VM, say. Each
            request gets a stream of its own; a refused or reset one
            doesn't touch Link's control stream. Timmy's own boards, and
            boards with display.draw_file, always have it. Costs a few KB
            of flash and a small queue in RAM.

    config HOMEHUB_DEV_BUILD
        bool "Dev build (dev signing key + dev-only affordances)"
        default y
        help
            Marks this as a development build. Default y, so a plain
            `idf.py build` is a dev build signed with the committed
            dev_signing_key.pem. Internal release builds set this to n and
            point signing at the secret release key.
            Firmware can branch on it with `#if CONFIG_HOMEHUB_DEV_BUILD`.
            Dev builds may log sensitive support details such as network
            identifiers and VM metadata. They must never log credentials,
            authorization headers, signed URL query parameters, private keys,
            or arbitrary response bodies.

    config HOMEHUB_BLE_NAME_PREFIX
        string "Visible BLE name prefix"
        default "Timmy"
        help
            The device advertises as "<prefix><suffix>-XXXXXX", where XXXXXX
            is the last three Wi-Fi STA MAC octets. Keep prefix and suffix
            together at most 22 characters so the name fits the BLE scan
            response. The backend node_id ("homelink-XXXXXX") does not change.

    config HOMEHUB_BLE_NAME_SUFFIX
        string "Visible BLE name suffix"
        default ""
        help
            Appended to HOMEHUB_BLE_NAME_PREFIX. Bench boards set one, such as
            "-Disp", so they are easy to tell apart while keeping the build's
            prefix: Timmy-Disp in the open-source build, HomeLink-Disp in
            the internal one.

    config HOMEHUB_BUTTON_GPIO
        int "Active-low setup/reset button GPIO"
        range 0 28 if IDF_TARGET_ESP32C5
        range 0 48
        default 28 if IDF_TARGET_ESP32C5
        default 41
        help
            GPIO connected to the button, independently of the status LED.
            Uses an internal pull-up and treats a low level as pressed.
            Timmy Home Link and the ESP32-C5 DevKitC-1 BOOT button both use GPIO28.

    config HOMEHUB_BUTTON_LABEL
        string "Button label shown in status prompts"
        default "BOOT"
        help
            The name shown in prompts like "Press <label> to confirm".
            Board overlays override this when the physical button has
            its own name.

    choice HOMEHUB_LED_BACKEND
        prompt "Status LED hardware"
        default HOMEHUB_LED_BACKEND_TIMMY
        help
            Select the physical status LED implementation for this build. The
            Timmy Home Link board uses a 3-channel PWM RGB LED. A stock
            ESP32-C5 DevKitC-1 has a single addressable RGB LED on GPIO27;
            other boards with one set HOMEHUB_LED_STRIP_GPIO.
            The always-on red power LED on the DevKitC-1 is not firmware
            controlled. The ideaspark ESP32 board, the SenseCAP Indicator and
            the ESP32-2432S028 Cheap Yellow Display have no status LED;
            their displays show the status colour in bars
            along the top and bottom edges, with an animation in between. The
            Home Assistant Voice PE shows the status colour on its LED ring.
            Seeed reSpeaker Lite shows it on a single RGB LED.
            The reTerminal E1001 and E1002 show a still status screen on
            their e-paper instead (black and white on the E1001, six colours
            on the E1002).
            The Waveshare ESP32-S3-ePaper-1.54G does the same in four colours.
            The ESP32-C3 with a 0.42 inch OLED shows the status and the
            agent's name as text.
            Boards with the full UI have no status LED; their screen shows Link's pairing
            and connection state instead.

        config HOMEHUB_LED_BACKEND_TIMMY
            bool "Timmy display"
            depends on TIMMY_ENABLED

    endchoice

    config HOMEHUB_DISPLAY_COMMANDS
        bool
        default y if HOMEHUB_LED_BACKEND_TIMMY && SPIRAM && (ESP_ROM_HAS_JPEG_DECODE || SOC_JPEG_DECODE_SUPPORTED)
        select HOMEHUB_DAEMON_REQUESTS   # display.draw_file reads from the VM
        help
            Set when display.draw_url and display.draw_file can draw an
            image: the display backends, and boards with the full UI, PSRAM
            for the image and a JPEG decoder in ROM or hardware.

    config HOMEHUB_NVS_ENCRYPTION
        bool "Encrypt NVS with an HMAC-derived key"
        default n
        select NVS_ENCRYPTION
        select NVS_SEC_KEY_PROTECT_USING_HMAC
        help
            Encrypt the NVS partition using an HMAC key from eFuse block
            NVS_SEC_HMAC_EFUSE_KEY_ID (set in the NVS component menu). At
            first boot, if the chosen block is empty and read-protection can
            still be set, the application generates a key automatically.
            Boards with no HMAC key and a locked eFuse fall back to plaintext
            NVS. When this option is off, NVS is always plaintext regardless
            of eFuse state.

    config HOMEHUB_PAIRING_EFUSE_AUTH
        bool "Enable manufacturer eFuse pairing attestation"
        default n
        help
            Enable official v5 pairing with a protected manufacturer P-256 key.
            Requires hardware Secure Boot. An exactly unused key block selects
            explicit community v5 pairing; any malformed or unusable key fails
            closed. With this off, all pairing is community v5 with fresh ECDH
            encryption and physical confirmation but no manufacturer proof.

    config HOMEHUB_PAIRING_AUTH_EPOCH
        int "Manufacturer pairing public-key epoch"
        range 1 1
        default 1
        help
            Public-key epoch for official eFuse attestation only. Community
            pairing always advertises epoch zero and has no manufacturer key.

    config HOMEHUB_PAIRING_ECDSA_EFUSE_BLOCK
        int "Manufacturer pairing ECDSA eFuse key block"
        depends on HOMEHUB_PAIRING_EFUSE_AUTH
        default 6
        help
            The esp_efuse_block_t value of the read/write-protected ECDSA key:
            EFUSE_BLK_KEY0=4, KEY1=5, KEY2=6, ... KEY5=9.
            Manufacturing provisions the pairing key in KEY2 before Secure Boot
            locks read protection. No shared software attestation key is used.

endmenu
```
